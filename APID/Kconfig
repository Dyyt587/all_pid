## APID/Kconfig
```kconfig
# Kconfig file for package APID
menuconfig PKG_USING_APID
    bool "Please add description of APID in English."
    default n

if PKG_USING_APID

    config PKG_APID_PATH
        string
        default "/packages/peripherals/sensors/APID"

    choice
        prompt "Version"
        help
            Select the package version

        config PKG_USING_APID_V102
            bool "v1.0.2"

        config PKG_USING_APID_LATEST_VERSION
            bool "latest"
    endchoice

    config PKG_APID_VER
       string
       default "v1.0.2"    if PKG_USING_APID_V102
       default "latest"    if PKG_USING_APID_LATEST_VERSION

endif
```
